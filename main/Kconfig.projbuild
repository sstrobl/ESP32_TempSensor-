## main/Kconfig.projbuild
```kconfig
menu "Temp Sensor Konfiguration"

    # Nur Vorgaben fuer den ersten Start. Danach gilt die Datei config.txt auf
    # dem USB-Laufwerk des Geraets. Keine echten Zugangsdaten einchecken!

    config WIFI_SSID
        string "WLAN SSID"
        default "meinWLAN"

    config WIFI_PASSWORD
        string "WLAN Passwort"
        default "meinPasswort"

    config MQTT_BROKER_URI
        string "MQTT Broker URI"
        default "mqtt://homeassistant.local:1883"
        help
            z.B. mqtt://192.168.1.10:1883

    config MQTT_USERNAME
        string "MQTT Benutzername (leer = anonym)"
        default ""

    config MQTT_PASSWORD
        string "MQTT Passwort"
        default ""

    config DEVICE_NAME
        string "Anzeigename in Home Assistant"
        default "ESP32 Temperatursensor"

    config SAMPLE_INTERVAL_S
        int "Messintervall (Sekunden)"
        range 1 3600
        default 30

    config PULLUP_OHMS
        int "Vorwiderstand nach 3,3 V (Ohm)"
        default 2400

    config KTY_R25_OHMS
        int "KTY Nennwiderstand bei 25 Grad C (Ohm)"
        default 2000
        help
            1000 fuer KTY81-110/120, 2000 fuer KTY81-210/220.
            Die Kennlinie in kty.c wird entsprechend skaliert.

    config TEMP_OFFSET_CENTI
        int "Temperatur-Offset in 0,01 Grad C (Kalibrierung)"
        default 0

endmenu
```
